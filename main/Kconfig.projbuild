## main/Kconfig.projbuild
```kconfig
menu "Xiaozhi Assistant"

config OTA_URL
    string "Default OTA URL"
    default "https://animodoll.com/xiaozhi/ota/"
    help
        The application will access this URL to check for new firmwares and server address.

config OTA_MANIFEST_PUBLIC_KEY_BASE64
    string "OTA manifest ECDSA public key (base64 DER)"
    default ""
    help
        Base64-encoded SubjectPublicKeyInfo DER for the production OTA manifest
        signing key. Firmware updates fail closed while this value is empty.

choice WAKE_WORD_TYPE
    prompt "Wake Word Implementation Type"
    default USE_AFE_WAKE_WORD
    help
        Choose the type of wake word implementation to use

    config USE_AFE_WAKE_WORD
        bool "Wakenet model (Default)"
    
    config USE_CUSTOM_WAKE_WORD
        bool "Multinet model (Custom Wake Word)"
        depends on IDF_TARGET_ESP32S3 && SPIRAM
endchoice

config CUSTOM_WAKE_WORD
    string "Custom Wake Word"
    default "xiao tu dou"
    depends on USE_CUSTOM_WAKE_WORD
    help
        Custom Wake Word, use pinyin for Chinese, separated by spaces

config CUSTOM_WAKE_WORD_DISPLAY
    string "Custom Wake Word Display"
    default "你好小豚"
    depends on USE_CUSTOM_WAKE_WORD
    help
        Greeting sent to the server after wake word detection

config CUSTOM_WAKE_WORD_ALIASES
    string "Custom Wake Word Aliases"
    default "ni hao xiao tong;ni hao xiao tun"
    depends on USE_CUSTOM_WAKE_WORD
    help
        Extra pinyin phrases that map to the same wake action, separated by semicolons.
        This helps custom MultiNet wake words tolerate common pronunciation variants.

config CUSTOM_WAKE_WORD_THRESHOLD
    int "Custom Wake Word Threshold (%)"
    default 10
    range 1 99
    depends on USE_CUSTOM_WAKE_WORD
    help
        Custom Wake Word Threshold, range 1-99, the smaller the more sensitive, default 10


choice
    prompt "语言选择"
    default LANGUAGE_ZH_CN
    help
        Select device display language

    config LANGUAGE_ZH_CN
        bool "Chinese"
    config LANGUAGE_ZH_TW
        bool "Chinese Traditional"
    config LANGUAGE_EN_US
        bool "English"
    config LANGUAGE_JA_JP
        bool "Japanese"
endchoice


choice CONNECTION_TYPE
    prompt "Connection Type"
    default CONNECTION_TYPE_MQTT_UDP
    help
        网络数据传输协议
    config CONNECTION_TYPE_MQTT_UDP
        bool "MQTT + UDP"
    config CONNECTION_TYPE_WEBSOCKET
        bool "Websocket"
endchoice

config WEBSOCKET_URL
    string "Websocket URL"
    default "ws://47.93.153.35:18000/xiaozhi/v1/"
    help
        Communication with the server through websocket after wake up.

config WEBSOCKET_ACCESS_TOKEN
    string "Websocket Access Token"
    default "test-token"
    help
        Access token for websocket communication.

choice BOARD_TYPE
    prompt "Board Type"
    default BOARD_TYPE_BREAD_COMPACT_WIFI
    help
        Board type. 开发板类型
    config BOARD_TYPE_BREAD_COMPACT_WIFI
        bool "面包板新版接线（WiFi）"
    config BOARD_TYPE_MOVECALL_CUICAN_ESP32S3
         bool "Movecall CuiCan 璀璨·AI吊坠"
endchoice

choice DISPLAY_OLED_TYPE
    depends on BOARD_TYPE_BREAD_COMPACT_WIFI
    prompt "OLED Type"
    default OLED_SSD1306_128X32
    help
        OLED 屏幕类型选择
    config OLED_SSD1306_128X32
        bool "SSD1306, 分辨率128*32"
    config OLED_SSD1306_128X64
        bool "SSD1306, 分辨率128*64"
    config OLED_SH1106_128X64
        bool "SH1106, 分辨率128*64"
endchoice


config USE_WECHAT_MESSAGE_STYLE
    bool "使用微信聊天界面风格"
    default n
    help
        使用微信聊天界面风格

config USE_WAKE_WORD_DETECT
    bool "启用唤醒词检测"
    default y
    depends on IDF_TARGET_ESP32S3 && SPIRAM
    help
        需要 ESP32 S3 与 AFE 支持

config USE_AUDIO_PROCESSOR
    bool "启用音频降噪、增益处理"
    default y
    depends on IDF_TARGET_ESP32S3 && SPIRAM
    help
        需要 ESP32 S3 与 AFE 支持

config USE_REALTIME_CHAT
    bool "启用可语音打断的实时对话模式（需要 AEC 支持）"
    default n
    depends on USE_AUDIO_PROCESSOR
    help
        需要 ESP32 S3 与 AEC 开启，因为性能不够，不建议和微信聊天界面风格同时开启
        
config ENABLE_BLE_RELAY
    bool "Enable BLE relay transport"
    default y
    depends on IDF_TARGET_ESP32S3
    help
        Enable BLE relay mode that connects the device to a phone app.

config BLE_RELAY_DEVICE_NAME_PREFIX
    string "BLE relay device name prefix"
    default "XiaoTun"
    depends on ENABLE_BLE_RELAY
    help
        Prefix used for the BLE peripheral name shown to the mobile app.
endmenu

menu "Battery"

config BATTERY_ADC_GPIO
    int "Battery voltage ADC GPIO (ADC1 pins 1-10), -1 to disable"
    default -1
    help
        GPIO that samples the battery through a resistor divider.
        Core board v1 uses GPIO2 (ADC1_CH1) with a 100k/100k divider.

config BATTERY_ADC_DIVIDER_PCT
    int "Divider ratio times 100"
    default 200
    help
        (R_top + R_bottom) / R_bottom, times 100. 100k/100k -> 200.

endmenu
```
